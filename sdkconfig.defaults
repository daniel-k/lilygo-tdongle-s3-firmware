## sdkconfig.defaults
```kconfig
# Bluetooth - controller only
CONFIG_BT_ENABLED=y
CONFIG_BT_CONTROLLER_ONLY=y
CONFIG_BT_CONTROLLER_ENABLED=y
CONFIG_BT_CTRL_HCI_MODE_UART_H4=y
CONFIG_BT_CTRL_HCI_TL=0
CONFIG_BT_CTRL_BLE_ADV_REPORT_FLOW_CTRL_SUPP=n
CONFIG_BT_CTRL_BLE_SCAN_DUPL=n

# Flash
CONFIG_ESPTOOLPY_FLASHSIZE_4MB=y

# Disable USB Serial/JTAG so OTG can use the PHY
CONFIG_ESP_CONSOLE_SECONDARY_NONE=y
CONFIG_USJ_ENABLE_USB_SERIAL_JTAG=n
```
